## components/sc_gamelink/Kconfig
```kconfig
menu "SC Bridge / GameLink"

    config SC_BRIDGE_ENABLED
        bool "Enable SC-Bridge network connection and GameLink event dispatcher"
        default n
        help
            When enabled the firmware will:
              - Start sc_network (Wi-Fi + WebSocket client) to connect to the
                PC-side sc-bridge daemon.
              - Start sc_gamelink to receive and dispatch game-state events
                (gear, shields, quantum drive, etc.) over that connection.
              - Show the Pairing screen on first boot until a bridge host is
                configured.

            Disable this option when the hardware is being used as a standalone
            HID controller without a running sc-bridge instance on the PC.
            The USB HID, LVGL UI, and SD-card ship layouts continue to work
            normally; only real-time game-state feedback is suppressed.

endmenu
```

## components/sc_network/Kconfig
```kconfig
menu "SC Network"

    config SC_NETWORK_DEV_FALLBACK
        bool "Use development Wi-Fi fallback when NVS is unpopulated"
        default n
        help
            When enabled, sc_network will use the credentials below if no
            Wi-Fi SSID is stored in NVS. Disable before production build.

    config SC_NETWORK_DEV_SSID
        string "Development fallback SSID"
        default ""
        depends on SC_NETWORK_DEV_FALLBACK
        help
            SSID used when NVS contains no Wi-Fi credentials.

    config SC_NETWORK_DEV_PSK
        string "Development fallback passphrase"
        default ""
        depends on SC_NETWORK_DEV_FALLBACK
        help
            WPA2 passphrase used when NVS contains no Wi-Fi credentials.

endmenu
```

## main/Kconfig.projbuild
```kconfig
menu "HotBox Configuration"

    config HOTBOX_BUILD_TOUCH
        bool "Build HotBox Touch (Full touchscreen reTerminal target - ESP32-P4)"
        default y if IDF_TARGET_ESP32P4
        default n
        help
            Build for HotBox Touch (ESP32-P4).

    config HOTBOX_BUILD_LITE
        bool "Build HotBox Lite (Headless S3 target - ESP32-S3)"
        default y if IDF_TARGET_ESP32S3
        default n
        help
            Build for HotBox Lite (ESP32-S3).

    config HOTBOX_BUILD_TINY
        bool "Build HotBox Tiny (Headless C3 target - ESP32-C3)"
        default y if IDF_TARGET_ESP32C3
        default n
        help
            Build for HotBox Tiny (ESP32-C3).

    menu "Wi-Fi Configuration"
        config HOTBOX_WIFI_FALLBACK
            bool "Use development Wi-Fi fallback when NVS is unpopulated"
            default y
            help
                When enabled, the network subsystem will fall back to the credentials configured
                below if no Wi-Fi SSID is stored in NVS.

        config HOTBOX_WIFI_SSID
            string "Fallback Wi-Fi SSID"
            default "HotBox_AP"
            depends on HOTBOX_WIFI_FALLBACK
            help
                The default Wi-Fi SSID to connect to when no SSID is stored in NVS.

        config HOTBOX_WIFI_PASSWORD
            string "Fallback Wi-Fi Password"
            default "hotbox123"
            depends on HOTBOX_WIFI_FALLBACK
            help
                The default Wi-Fi password.
    endmenu

    menu "DevKit Configuration"
        config HOTBOX_DEVKIT_BOARD_NAME
            string "DevKit Board Identifier"
            default "reTerminal D1001" if IDF_TARGET_ESP32P4
            default "ESP32-S3-DevKit" if IDF_TARGET_ESP32S3
            default "ESP32-C3-DevKit" if IDF_TARGET_ESP32C3
            help
                A text label to identify the hardware revision/devkit board.
    endmenu

    menu "Optional Features"
        config SC_BRIDGE_ENABLED
            bool "Enable SC-Bridge network connection and GameLink event dispatcher"
            default n
            help
                When enabled the firmware will start sc_network and connect to the PC-side sc-bridge daemon.
    endmenu

endmenu
```

## sdkconfig.defaults
```kconfig
# ======================================================================
#  SC Terminal — sdkconfig.defaults
#  Target : ESP32-P4  (reTerminal D1001 — ESP32-P4NRW32)
#  Run    : idf.py set-target esp32p4  (once, before first build)
# ======================================================================

# --------------- Target -------------------------------------------------
CONFIG_IDF_TARGET="esp32p4"

# ESP32-P4 silicon revision — reTerminal D1001 ships with silicon v1.3 (FULL=103).
# IDF 6.0.1 defaults to requiring v3.1 (FULL=301); override to v1.0 (FULL=100)
# so the bootloader accepts v1.x chips.
# IMPORTANT: ESP32P4_REV_MIN_100 depends on ESP32P4_SELECTS_REV_LESS_V3 — must be
# set first.  Rev <3.0 and >=3.0 are mutually exclusive silicon lines; reTerminal
# uses the v1.x line.
CONFIG_ESP32P4_SELECTS_REV_LESS_V3=y
CONFIG_ESP32P4_REV_MIN_100=y

# --------------- CPU ----------------------------------------------------
CONFIG_ESP32P4_DEFAULT_CPU_FREQ_MHZ_400=y

# --------------- PSRAM (32 MB on-package OCT) ---------------------------
CONFIG_SPIRAM=y
CONFIG_SPIRAM_MODE_OCT=y
CONFIG_SPIRAM_SPEED_200M=y
CONFIG_SPIRAM_MALLOC_ALWAYSINTERNAL=65536
CONFIG_SPIRAM_MALLOC_RESERVE_INTERNAL=32768
CONFIG_SPIRAM_USE_CAPS_ALLOC=y

# --------------- Flash --------------------------------------------------
CONFIG_ESPTOOLPY_FLASHSIZE_32MB=y
CONFIG_PARTITION_TABLE_CUSTOM=y
CONFIG_PARTITION_TABLE_CUSTOM_FILENAME="partitions.csv"

# --------------- Development Wi-Fi fallback ----------------------------
# Remove or set to n before any production build.
CONFIG_SC_NETWORK_DEV_FALLBACK=y
CONFIG_SC_NETWORK_DEV_SSID="Waterways"
CONFIG_SC_NETWORK_DEV_PSK="RiverS0ng"

# --------------- SC-Bridge / GameLink ----------------------------------
# Set to y to enable Wi-Fi + WebSocket bridge connection and game-state
# event dispatching. Disabled by default for standalone HID use.
CONFIG_SC_BRIDGE_ENABLED=n

# --------------- Task Watchdog -----------------------------------------
# SVG rasterization via ThorVG can block a single core for 10-20 seconds
# per sprite. Raise the WDT timeout so the rasterizer task is not flagged.
# IDLE health is maintained by the inter-sprite vTaskDelay(10ms) yields.
CONFIG_ESP_TASK_WDT_TIMEOUT_S=30
CONFIG_ESP_TASK_WDT_PANIC=n

# --------------- USB / TinyUSB ------------------------------------------
# TINYUSB_HID_COUNT>0 enables HID and sets CFG_TUD_HID in the build.
# We use 1 HID interface with 2 reports (keyboard + consumer control).
CONFIG_TINYUSB_HID_COUNT=1
# Suppress the esp_tinyusb background task; sc_hid.c runs its own USB poll task.
CONFIG_TINYUSB_NO_DEFAULT_TASK=y
CONFIG_TINYUSB_DESC_USE_ESPRESSIF_VID=n
CONFIG_TINYUSB_RHPORT_HS=n
CONFIG_TINYUSB_RHPORT_FS=y

# --------------- FreeRTOS -----------------------------------------------
CONFIG_FREERTOS_HZ=1000
CONFIG_FREERTOS_UNICORE=n
CONFIG_FREERTOS_SUPPORT_STATIC_ALLOCATION=y
CONFIG_FREERTOS_ENABLE_BACKWARD_COMPATIBILITY=n

# --------------- LVGL Fonts ---------------------------------------------
# 8" 800x1280 display — enable the font sizes used by sc_ui_theme.h
CONFIG_LV_FONT_MONTSERRAT_20=y
CONFIG_LV_FONT_MONTSERRAT_36=y

# --------------- Logging ------------------------------------------------
CONFIG_LOG_DEFAULT_LEVEL_INFO=y
CONFIG_LOG_MAXIMUM_LEVEL_DEBUG=y
CONFIG_LOG_COLORS=y

# --------------- NVS ----------------------------------------------------
CONFIG_NVS_ENCRYPTION=n

# --------------- SPIFFS -------------------------------------------------
CONFIG_SPIFFS_PAGE_SIZE=256
CONFIG_SPIFFS_GC_MAX_RUNS=10
CONFIG_SPIFFS_CACHE=y
CONFIG_SPIFFS_MAX_PARTITIONS=3

CONFIG_ESP_HOST_WIFI_ENABLED=n
CONFIG_ESP_WIFI_REMOTE_ENABLED=y
CONFIG_ESP_HOSTED_MEMPOOL_PREFER_SPIRAM=y
CONFIG_ESP_WIFI_STATIC_RX_BUFFER_NUM=10
CONFIG_ESP_WIFI_DYNAMIC_RX_BUFFER_NUM=32
# TX buffer choice (dynamic=1 → sets CONFIG_ESP_WIFI_TX_BUFFER_TYPE=1)
CONFIG_ESP_WIFI_DYNAMIC_TX_BUFFER=y
CONFIG_ESP_WIFI_DYNAMIC_TX_BUFFER_NUM=32
# MGMT RX buffer choice (static → sets CONFIG_ESP_WIFI_DYNAMIC_RX_MGMT_BUF=0)
CONFIG_ESP_WIFI_STATIC_RX_MGMT_BUFFER=y
CONFIG_ESP_WIFI_AMPDU_TX_ENABLED=y
CONFIG_ESP_WIFI_AMPDU_RX_ENABLED=y
CONFIG_ESP_WIFI_NVS_ENABLED=n
CONFIG_ESP_WIFI_ESPNOW_MAX_ENCRYPT_NUM=0

CONFIG_ESP_HOSTED_ENABLED=y
CONFIG_ESP_HOSTED_CP_TARGET_ESP32C6=y
CONFIG_ESP_HOSTED_IDF_SLAVE_TARGET="esp32c6"
CONFIG_ESP_HOSTED_P4_DEV_BOARD_NONE=y
# SDIO transport (hardware is wired for SDIO, not SPI)
CONFIG_ESP_HOSTED_SDIO_HOST_INTERFACE=y
CONFIG_ESP_HOSTED_SDIO_SLOT_1=y
CONFIG_ESP_HOSTED_SDIO_4_BIT_BUS=y
CONFIG_ESP_HOSTED_SDIO_CLOCK_FREQ_KHZ=40000
CONFIG_ESP_HOSTED_SDIO_RESET_ACTIVE_HIGH=y
CONFIG_ESP_HOSTED_SDIO_GPIO_RESET_SLAVE=13
CONFIG_ESP_HOSTED_PRIV_SDIO_PIN_CLK_SLOT_1=11
CONFIG_ESP_HOSTED_PRIV_SDIO_PIN_CMD_SLOT_1=6
CONFIG_ESP_HOSTED_PRIV_SDIO_PIN_D0_SLOT_1=7
CONFIG_ESP_HOSTED_PRIV_SDIO_PIN_D1_4BIT_BUS_SLOT_1=8
CONFIG_ESP_HOSTED_PRIV_SDIO_PIN_D2_4BIT_BUS_SLOT_1=9
CONFIG_ESP_HOSTED_PRIV_SDIO_PIN_D3_4BIT_BUS_SLOT_1=10
CONFIG_ESP_HOSTED_SLAVE_RESET_ON_EVERY_HOST_BOOTUP=y
CONFIG_ESP_HOSTED_GPIO_SLAVE_RESET_SLAVE=13
CONFIG_ESP_HOSTED_RPC_TASK_STACK=4096
CONFIG_ESP_HOSTED_DFLT_TASK_STACK=3072
CONFIG_ESP_HOSTED_TRANSPORT_RESTART_ON_FAILURE=y
CONFIG_ESP_HOSTED_MEM_MONITOR=y
CONFIG_ESP_HOSTED_USE_MEMPOOL=y
CONFIG_ESP_HOSTED_MAX_SIMULTANEOUS_SYNC_RPC_REQUESTS=5
CONFIG_ESP_HOSTED_MAX_SIMULTANEOUS_ASYNC_RPC_REQUESTS=5
CONFIG_ESP_HOSTED_CLI_ENABLED=y
CONFIG_ESP_HOSTED_HOST_TO_ESP_WIFI_DATA_THROTTLE=y
CONFIG_ESP_HOSTED_TO_WIFI_DATA_THROTTLE_HIGH_THRESHOLD=90
CONFIG_ESP_HOSTED_TO_WIFI_DATA_THROTTLE_LOW_THRESHOLD=60
CONFIG_ESP_HOSTED_ENABLE_PEER_DATA_TRANSFER=y
CONFIG_ESP_HOSTED_MAX_CUSTOM_MSG_HANDLERS=3

# --------------- HTTP / WebSocket (built-in IDF) ------------------------
CONFIG_ESP_WEBSOCKET_CLIENT_BUFFER_SIZE=4096
CONFIG_ESP_HTTP_CLIENT_ENABLE_HTTPS=y

# --------------- HEAP ---------------------------------------------------
CONFIG_HEAP_POISONING_DISABLED=y
CONFIG_HEAP_TRACING_STANDALONE=n

# --------------- Compiler -----------------------------------------------
CONFIG_COMPILER_OPTIMIZATION_PERF=y
CONFIG_COMPILER_CXX_EXCEPTIONS=n
CONFIG_COMPILER_CXX_RTTI=n

# --------------- Console ------------------------------------------------
CONFIG_ESP_CONSOLE_USB_SERIAL_JTAG=y
CONFIG_ESP_CONSOLE_UART_DEFAULT=n
CONFIG_ESP_CONSOLE_UART=n

# --------------- LVGL OS ------------------------------------------------
CONFIG_LV_OS_FREERTOS=y
CONFIG_LV_DRAW_THREAD_STACK_SIZE=32768
CONFIG_COMPILER_DISABLE_DEFAULT_ERRORS=y

# --------------- LVGL FS ------------------------------------------------
CONFIG_LV_USE_FS_POSIX=y
CONFIG_LV_FS_POSIX_LETTER=83
CONFIG_LV_FS_POSIX_PATH="/sdcard"
CONFIG_LV_FS_POSIX_CACHE_SIZE=16384
CONFIG_LV_CACHE_DEF_SIZE=4194304
CONFIG_LV_IMAGE_HEADER_CACHE_DEF_CNT=64

# --------------- LVGL Vector Graphic & SVG & PNG -----------------
CONFIG_LV_USE_VECTOR_GRAPHIC=y
CONFIG_LV_USE_SVG=y
CONFIG_LV_USE_LODEPNG=y
CONFIG_LV_USE_THORVG=y
CONFIG_LV_USE_THORVG_INTERNAL=y
```

## sdkconfig.defaults.esp32c3
```kconfig
# Target options
CONFIG_IDF_TARGET="esp32c3"
CONFIG_IDF_TARGET_ESP32C3=y

# Disable ESP-Hosted/Remote Wi-Fi (use native C3 Wi-Fi instead)
CONFIG_ESP_HOSTED_ENABLED=n
CONFIG_ESP_WIFI_REMOTE_ENABLED=n
```

## sdkconfig.defaults.esp32s3
```kconfig
# Target options
CONFIG_IDF_TARGET="esp32s3"
CONFIG_IDF_TARGET_ESP32S3=y

# Serial console to UART
CONFIG_ESP_CONSOLE_UART_DEFAULT=y
CONFIG_ESP_CONSOLE_SECONDARY_NONE=y

# 16MB Flash Configuration
CONFIG_ESPTOOLPY_FLASHSIZE_16MB=y
CONFIG_ESPTOOLPY_FLASHMODE_DIO=y
CONFIG_ESPTOOLPY_FLASHFREQ_80M=y
CONFIG_ESPTOOLPY_FLASHSIZE="16MB"

# 8MB Octal PSRAM Configuration
CONFIG_SPIRAM=y
CONFIG_SPIRAM_MODE_OCT=y
CONFIG_SPIRAM_SPEED_80M=y
CONFIG_SPIRAM_BOOT_TIME_CLEANUP=y
CONFIG_SPIRAM_TYPE_AUTO=y
CONFIG_SPIRAM_USE_CAPS_ALLOC=y
CONFIG_SPIRAM_MEMTEST=n

# Partition Table
CONFIG_PARTITION_TABLE_CUSTOM=y
CONFIG_PARTITION_TABLE_CUSTOM_FILENAME="partitions_esp32s3.csv"
CONFIG_PARTITION_TABLE_FILENAME="partitions_esp32s3.csv"

# Wi-Fi / LwIP / Network
CONFIG_ESP32_WIFI_ENABLED=y
CONFIG_ESP_NETIF_TCPIP_ADAPTER_COMPATIBLE_SYSTEM=y
CONFIG_LWIP_MAX_ACTIVE_TCP=16
CONFIG_LWIP_MAX_LISTENING_TCP=16

# Web Portal & WebSocket settings
CONFIG_HTTPD_MAX_OPEN_SOCKETS=7
CONFIG_HTTPD_MAX_URI_HANDLERS=16

# Disable Seeed BSP or specific P4 components on S3
CONFIG_SC_BSP_D1001=n
CONFIG_SC_BRIDGE_ENABLED=n

# TinyUSB Settings
CONFIG_TINYUSB=y
CONFIG_TINYUSB_CDC_NUM=0
CONFIG_TINYUSB_HID_NUM=1

# Enable HTTPD WebSocket Server Support
CONFIG_HTTPD_WS_SUPPORT=y

# Disable ESP-Hosted/Remote Wi-Fi (use native S3 Wi-Fi instead)
CONFIG_ESP_HOSTED_ENABLED=n
CONFIG_ESP_WIFI_REMOTE_ENABLED=n
```
